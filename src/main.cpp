#include <Wire.h>
#include <Adafruit_GFX.h>
#include <Adafruit_SSD1306.h>
#include <cstdlib>
#include <ctime>
#include <cmath>

#define SCREEN_WIDTH 128 // OLED display width, in pixels
#define SCREEN_HEIGHT 64 // OLED display height, in pixels  
int playersPosition[] = {-1,-1};  // both players position in the y, no need for x since its stays on the same x obvi
double circlePosition[]={128/2,64/2};
double BALL_SPEED=-1;
int sum1 = 0;
int sum2 = 0;
int startAngle=90;
int n =0;
int xDirection=1,yDirection=1;
int player1Score=0, player2Score=0;

// Declaration for an SSD1306 display connected to I2C (SDA, SCL pins)
Adafruit_SSD1306 display(SCREEN_WIDTH, SCREEN_HEIGHT, &Wire, -1);
int counter=0;
const u_int8_t bitmap[] PROGMEM = {0x0,0x0,0x0,0x0,0x0,0x0,0x0,0x0,0x0,0x0,0x0,0x0,0x0,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0x0,0x0};
void setup() {
  Serial.begin(115200);
  pinMode(13,INPUT);
  pinMode(34,INPUT);

  randomSeed(analogRead(0));
  startAngle = random(360);
  

  if(!display.begin(SSD1306_SWITCHCAPVCC, 0x3C)) { // Address 0x3D for 128x64
    Serial.println(F("SSD1306 allocation failed"));
    for(;;);
  }
  delay(2000);
  display.clearDisplay();


 
}
void resetGame(){
  xDirection=1;
  yDirection=1;
  BALL_SPEED=-1;
  circlePosition[0]=128/2;
  circlePosition[1]=64/2;
  startAngle=90;
  return;
  
}

void figureOutDirection(int playerNum){
  /*
    set angle of ball after hitting player
  */
  int offset = round(circlePosition[1]) - playersPosition[playerNum];
  startAngle = constrain(90 + (offset - 5) * 10, 40, 160);
  xDirection *= -1;
  

}

void winScreen(){
  /*
    Once score is made display information about scores
  */
    display.clearDisplay();
    display.drawBitmap(0,0,bitmap,128,64,1);
    display.setCursor(16, 16);
    display.setTextSize(2);
    display.setTextColor(SSD1306_WHITE);
    display.print(player1Score);
    display.print("-");
    display.print(player2Score);
    display.display();
    delay(2000);
}

void circleLogic(){
  /*
    deal with movement of ball
  */
  circlePosition[0]+=(xDirection)*(BALL_SPEED)*sin(startAngle*PI/180.0);
  circlePosition[1]+=(yDirection)*(BALL_SPEED)*cos(startAngle*PI/180.0);

  // if it hits top border
  if(circlePosition[0]<=1){
    // ball hits player 1
    if((circlePosition[1]<=(playersPosition[0]+11))&&(circlePosition[1]>=(playersPosition[0]-2))){
        BALL_SPEED-=0.2;
        figureOutDirection(0);
    }
    else{
      player2Score++;
      winScreen();
      resetGame();
    }
  }
  if(circlePosition[0]>=126){
    // ball hits player 2
    if((circlePosition[1]<=(playersPosition[1]+11))&&(circlePosition[1]>=(playersPosition[1]-2))){
      BALL_SPEED-=0.2;
      figureOutDirection(1);
    }
    else{
      player1Score++;
      winScreen();
      resetGame();
    }

  }
  if(circlePosition[1]<=0 || circlePosition[1]>=63)
  {
    yDirection*=-1;
  }

  display.fillCircle(round(circlePosition[0]),round(circlePosition[1]),1,1);


}


void calcAvg(){
  /*
    gets the average of the potentiometer to account or random voltage readings
  */
  int sum1=0,sum2=0;
  for(int i =0;i<10;i++){
    sum1+= analogRead(13)/64;
    sum2+= analogRead(34)/64;
  }
  playersPosition[0]= sum1/10;
  playersPosition[1]= sum2/10;

  return;

}
void loop() {
  /*
    game loop
  */
 
  display.clearDisplay();
  // deal with player position
  calcAvg();
  if(playersPosition[0]<64-10){
    display.writeFastVLine(0,playersPosition[0],10,1);
  }
  else{
    display.writeFastVLine(0,64-10,10,1);
    playersPosition[0]=64-10;
  }

  if(playersPosition[1]<64-10){

    display.writeFastVLine(127,playersPosition[1],10,1);
  }
  else{

    display.writeFastVLine(127,64-10,10,1);
    playersPosition[1]=64-10;
  }


  
  circleLogic();

  display.display();


  
  


  
}